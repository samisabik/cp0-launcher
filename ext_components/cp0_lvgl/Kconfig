## ext_components/cp0_lvgl/Kconfig
```kconfig
# SPDX-FileCopyrightText: 2026 M5Stack Technology CO LTD
# SPDX-License-Identifier: MIT


menuconfig CP0_LVGL_COMPONENT_ENABLED
    bool "Enable cp0 lvgl support"
    default n
```
